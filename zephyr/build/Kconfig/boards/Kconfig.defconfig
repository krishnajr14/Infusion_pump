## zephyr/build/Kconfig/boards/Kconfig.defconfig
```kconfig
# Load Zephyr board defconfig descriptions.
osource "/home/krishna-inc-5836/zephyrproject/zephyr/boards/st/nucleo_f446re/Kconfig.defconfig"
```

## zephyr/build/Kconfig/boards/Kconfig.nucleo_f446re
```kconfig
# Load board Kconfig descriptions.
osource "/home/krishna-inc-5836/zephyrproject/zephyr/boards/st/nucleo_f446re/Kconfig.nucleo_f446re"
```
